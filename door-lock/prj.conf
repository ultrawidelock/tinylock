## CMakeLists.txt
```
# SPDX-FileCopyrightText: 2026 Aseem Chopra
# SPDX-License-Identifier: Apache-2.0

cmake_minimum_required(VERSION 3.20.0)

# prj.conf holds the lines every build shares, stacks/*.conf one stack each.
# With no CONF_FILE given, build the stock stacks.
if(NOT DEFINED CONF_FILE)
  set(CONF_FILE "prj.conf;stacks/bt-host.conf;stacks/openthread.conf;stacks/nrf-security.conf")
endif()

find_package(Zephyr REQUIRED HINTS $ENV{ZEPHYR_BASE})
# tinytalk comes in from the command line, never from a path in this file.
if(NOT DEFINED ZEPHYR_TINYTALK_MODULE_DIR)
  message(FATAL_ERROR "tinytalk not found: pass it with -DZEPHYR_EXTRA_MODULES=<tinytalk>")
endif()
project(tinytalk_door_lock)

target_sources(app PRIVATE src/main.c)
target_sources_ifdef(CONFIG_TINYCRED app PRIVATE src/cred.c)

# The manual pairing code, for the boot log. scripts/spake2p_verifier.py
# re-derives the verifier from the passcode in this build's .config first, and
# the build stops if the two disagree: a code that does not match the verifier
# fails at Pake3 looking exactly like a typo.
execute_process(
  COMMAND ${PYTHON_EXECUTABLE} ${ZEPHYR_TINYTALK_MODULE_DIR}/scripts/spake2p_verifier.py
          --from-config ${DOTCONFIG}
  OUTPUT_VARIABLE TM_PAIRING_OUT
  ERROR_VARIABLE TM_PAIRING_ERR
  RESULT_VARIABLE TM_PAIRING_RC)
if(NOT TM_PAIRING_RC EQUAL 0)
  message(FATAL_ERROR "${TM_PAIRING_OUT}${TM_PAIRING_ERR}")
endif()
string(REGEX MATCH "setup code  ([0-9]+-[0-9]+-[0-9]+)" TM_PAIRING_MATCH "${TM_PAIRING_OUT}")
if(NOT CMAKE_MATCH_1)
  message(FATAL_ERROR "no setup code in: ${TM_PAIRING_OUT}")
endif()
message(STATUS "tinytalk manual pairing code: ${CMAKE_MATCH_1}")
target_compile_definitions(app PRIVATE TM_SAMPLE_MANUAL_CODE="${CMAKE_MATCH_1}")
```

## prj.conf
```kconfig
# tinytalk door-lock sample: a Matter Door Lock on an nRF52833, commissioned
# over BLE, operated over Thread. Measured facts below were measured in
# ultrawidelock, on its DWM3001CDK image, on the dates given.

# ---- tinytalk ---------------------------------------------------------------
CONFIG_TINYTALK=y
CONFIG_TINYTALK_DOOR_LOCK=y
CONFIG_GPIO=y
# The factory-reset press reboots.
CONFIG_REBOOT=y
# The fabric store and OpenThread keep their state in settings, on NVS.
CONFIG_FLASH=y
CONFIG_FLASH_MAP=y
CONFIG_NVS=y
CONFIG_SETTINGS=y
CONFIG_SETTINGS_NVS=y
# 16 KB, four NVS sectors: what the source image ran its fabrics, OpenThread and
# its reader keys in on hardware. The 8 KB default leaves one usable sector.
CONFIG_PM_PARTITION_SIZE_SETTINGS_STORAGE=0x4000
# The DWM3001CDK's devicetree enables its LIS2DH accelerometer; nothing here
# reads it.
CONFIG_LIS2DH=n
CONFIG_I2C=n
CONFIG_SIZE_OPTIMIZATIONS=y
# Link-time optimisation: 33,460 B less flash on the DWM3001CDK, measured
# 2026-10-16. The source project ran it on every Matter over Thread image and
# proved it on hardware on 2026-08-02, with a UWB walk-up unlock whose ranging
# path has a ~1836 us arm deadline.
#
# BOTH LINES ARE REQUIRED. `CONFIG_LTO=y` on its own is a silent no-op: the
# symbol depends on
#   !(GEN_ISR_TABLES || GEN_IRQ_VECTOR_TABLE) || ISR_TABLES_LOCAL_DECLARATION
# (zephyr/Kconfig.zephyr), and with that unmet Kconfig drops it from the
# generated .config without a warning. Grep the build's zephyr/.config for both
# before trusting a size.
#
# CONFIG_SIZE_OPTIMIZATIONS_AGGRESSIVE (-Oz) is a measured dead end: in the
# source project, 2026-08-22, it came out 1 byte smaller than -Os on this GCC,
# and -flto-partition=one bought nothing either.
CONFIG_LTO=y
CONFIG_ISR_TABLES_LOCAL_DECLARATION=y
CONFIG_HEAP_MEM_POOL_SIZE=4096
CONFIG_MAIN_STACK_SIZE=4096
# Measured 2026-08-02 from the stack paint, with the source's credential reader
# also on this queue: peak 3,872 B, and 4096 faulted. Not re-measured without it.
CONFIG_SYSTEM_WORKQUEUE_STACK_SIZE=6144

# ---- logging: RTT, the board's only console ---------------------------------------
CONFIG_UART_CONSOLE=n
CONFIG_LOG=y
CONFIG_LOG_MODE_MINIMAL=y
CONFIG_LOG_DEFAULT_LEVEL=3
CONFIG_USE_SEGGER_RTT=y
CONFIG_RTT_CONSOLE=y
# Boot output exceeds the 1 KB default, and a full buffer silently drops.
CONFIG_SEGGER_RTT_BUFFER_SIZE_UP=8192
```

## overlay-release.conf
```kconfig
# The release profile: no logging, no RTT console, no Bluetooth asserts, no boot
# banner. Add it to prj.conf with
#   west build ... -- -DEXTRA_CONF_FILE=overlay-release.conf
#
# Measured 2026-10-16 on decawave_dwm3001cdk, LTO on: 22,004 B less flash and
# 8,576 B less RAM than prj.conf alone, most of the RAM being the RTT buffer.
# The image says nothing over RTT, so keep a prj.conf build for debugging.
#
# Kconfig warns that prj.conf's logging and RTT values no longer apply; that is
# expected. CONFIG_PRINTK stays on: another symbol selects it, and with no
# console it prints nowhere.
CONFIG_LOG=n
CONFIG_CONSOLE=n
CONFIG_RTT_CONSOLE=n
CONFIG_USE_SEGGER_RTT=n
CONFIG_BT_ASSERT=n
CONFIG_ASSERT_VERBOSE=n
CONFIG_NCS_BOOT_BANNER=n
```

## src/main.c
```c
/* SPDX-FileCopyrightText: 2026 Aseem Chopra */
/* SPDX-License-Identifier: Apache-2.0 */

/*
 * tinytalk door-lock sample.
 *
 * Boot order, learned from the source project's commissioning glue:
 *
 *   1. PSA Crypto, then settings: the fabric store and OpenThread keep their
 *      state there, and the node signs and derives with PSA.
 *   2. Bluetooth, then the Matter node (matter_commission_init), which restores
 *      any stored fabric and, with Thread, rejoins the network.
 *   3. Advertise the 0xFFF6 commissionable service while there is no fabric.
 *
 * From there the commissioner drives it: PASE over BLE, the fabric added over
 * CASE, then the Thread attach and the SRP registration, both done by the node
 * and ports/zephyr/thread.
 *
 * The Door Lock cluster (clusters/door_lock) sits on endpoint 1 and drives
 * LED0: on while unlocked. Button 0: a short
 * press opens a basic commissioning window for WINDOW_S seconds; a press held
 * for FACTORY_RESET_MS erases the stored fabrics and reboots. In a tinyfota
 * build the short press also opens the update window.
 */
#include <app_version.h>
#include <zephyr/drivers/gpio.h>
#include <zephyr/fs/nvs.h>
#include <zephyr/kernel.h>
#include <zephyr/logging/log.h>
#include <zephyr/settings/settings.h>
#include <zephyr/sys/reboot.h>

#include <psa/crypto.h>

#include <tinytalk/matter_ble.h>
#include <tinytalk/matter_commission.h>
#include <tinytalk/matter_fab_store.h>
#include <tinytalk/matter_thread.h>
#include <tinytalk/tm_door_lock.h>

#if defined(CONFIG_TINYCRED)
#include "cred.h"
#endif

#if defined(CONFIG_TINYFOTA_RECEIVER)
#include <tinyfota_rx.h>
#endif

LOG_MODULE_REGISTER(door_lock, LOG_LEVEL_INF);

#define WINDOW_S         900u
#define FACTORY_RESET_MS 5000
/* The reboot after a factory reset waits at least SRP_RETRACT_MS, then every
 * SRP_RETRACT_POLL_MS while the SRP removals are in flight, up to
 * SRP_RETRACT_MAX_MS after the reset. */
#define SRP_RETRACT_MS      2000
#define SRP_RETRACT_POLL_MS 100
#define SRP_RETRACT_MAX_MS  5000

static const struct matter_commission_config s_matter_cfg = {
	.vendor_id = CONFIG_TINYTALK_VENDOR_ID,
	.product_id = CONFIG_TINYTALK_PRODUCT_ID,
	.verifier_hex = CONFIG_TINYTALK_SPAKE2P_VERIFIER,
	.salt_hex = CONFIG_TINYTALK_SPAKE2P_SALT,
	.iterations = CONFIG_TINYTALK_SPAKE2P_ITERATIONS,
	.product_name = "tinytalk door lock",
	.hardware_version = 1u,
	.software_version = APP_VERSION_NUMBER,
	.software_version_str = APP_VERSION_STRING,
	.endpoints = &tm_door_lock_endpoint,
	.n_endpoints = 1u,
};

static const struct gpio_dt_spec s_led = GPIO_DT_SPEC_GET(DT_ALIAS(led0), gpios);
static const struct gpio_dt_spec s_button = GPIO_DT_SPEC_GET(DT_ALIAS(sw0), gpios);

/* ---- advertising ------------------------------------------------------------
 *
 * The node asks for this through matter_commission_readvertise() with its own
 * lock held, so the work is done here, on the system work queue.
 */
static void adv_work_fn(struct k_work *work)
{
	bool want = !matter_commission_has_fabric() || matter_commission_window_open();

	ARG_UNUSED(work);
#if defined(CONFIG_TINYFOTA_RECEIVER)
	/* Connectable for the whole update window, which can outlast the
	 * commissioning window or open while one is already running. */
	want = want || tinyfota_window_is_open();
#endif
	/* The GATT table follows the advert: no commissioning service while the
	 * node is not offering to be commissioned. -EBUSY means a link is up and
	 * the next pass will try again. The transport repeats the last request
	 * when a connection ends, and logs every connect and disconnect. */
#if defined(CONFIG_TINYCRED)
	/* One advertiser: the commissioning advertisement while it is wanted,
	 * the credential reader's the rest of the time. Off before on. */
	if (want) {
		cred_advertise(false);
	}
#endif
	(void)matter_ble_advertise(want);
#if defined(CONFIG_TINYCRED)
	if (!want) {
		cred_advertise(true);
	}
#endif
}
static K_WORK_DEFINE(s_adv_work, adv_work_fn);

void matter_commission_readvertise(void)
{
	k_work_submit(&s_adv_work);
}

#if defined(CONFIG_TINYFOTA_RECEIVER)
static void on_update_window(bool open)
{
	ARG_UNUSED(open);
	k_work_submit(&s_adv_work);
}
#endif

/* ---- the bolt ---------------------------------------------------------------- */

void tm_door_lock_actuate(uint8_t lock_state)
{
	(void)gpio_pin_set_dt(&s_led, lock_state == MATTER_DL_LOCK_STATE_UNLOCKED);
	LOG_INF("door %s", lock_state == MATTER_DL_LOCK_STATE_UNLOCKED ? "unlocked" : "locked");
#if defined(CONFIG_TINYCRED)
	cred_bolt_moved(lock_state);
#endif
}

/* ---- the button --------------------------------------------------------------- */

static struct gpio_callback s_button_cb;
/* -1 until this boot sees a press: the press held through a factory-reset
 * reboot ends here as a bare release, which is not a short press. */
static int64_t s_pressed_at = -1;
/* When the factory reset started, for the SRP_RETRACT_MAX_MS cap. */
static int64_t s_reset_at;

static void reboot_fn(struct k_work *work)
{
#if defined(CONFIG_TINYTALK_HAS_THREAD)
	if (matter_thread_advertise_pending()) {
		if (k_uptime_get() - s_reset_at < SRP_RETRACT_MAX_MS) {
			(void)k_work_reschedule(k_work_delayable_from_work(work),
						K_MSEC(SRP_RETRACT_POLL_MS));
			return;
		}
		LOG_WRN("SRP removal still pending after %d ms; rebooting", SRP_RETRACT_MAX_MS);
	}
#else
	ARG_UNUSED(work);
#endif
	/* The fabric erase is logical: the old records, operational keys among
	 * them, stay in NVS until garbage collection, and OpenThread's dataset,
	 * network key and SRP key are not the node's to erase. Clearing the
	 * settings store takes all of it, PSA's stored keys included. */
	void *storage;

	if (settings_storage_get(&storage) == 0) {
		(void)nvs_clear(storage);
	}
	sys_reboot(SYS_REBOOT_COLD);
}
static K_WORK_DELAYABLE_DEFINE(s_reboot_work, reboot_fn);

/* The SRP records are retracted before the reboot: the border router otherwise
 * keeps advertising them for their lease (2 h asked for), and Apple Home dials
 * a stale commissionable record over Thread instead of using BLE. It connects
 * and never writes C1 (2026-10-16, dns-sd -B _matterc._udp). LED0 stays lit
 * while the removal goes out, so the reset is visible. */
static void factory_reset_fn(struct k_work *work)
{
	ARG_UNUSED(work);
	if (gpio_pin_get_dt(&s_button) != 1) {
		return;
	}
	LOG_WRN("button held: factory reset");
	s_reset_at = k_uptime_get();
	(void)gpio_pin_set_dt(&s_led, 1);
	(void)matter_fab_erase();
#if defined(CONFIG_TINYTALK_HAS_THREAD)
	matter_thread_advertise_reset();
#endif
	(void)k_work_reschedule(&s_reboot_work, K_MSEC(SRP_RETRACT_MS));
}
static K_WORK_DELAYABLE_DEFINE(s_factory_reset_work, factory_reset_fn);

static void open_window_fn(struct k_work *work)
{
	ARG_UNUSED(work);
	if (matter_commission_open_window(WINDOW_S) == 0) {
		LOG_INF("commissioning window open for %u s", WINDOW_S);
	} else {
		LOG_INF("commissioning window already open");
	}
#if defined(CONFIG_TINYFOTA_RECEIVER)
	tinyfota_window_open(CONFIG_TINYFOTA_WINDOW_MS);
	LOG_INF("update window open for %d ms", CONFIG_TINYFOTA_WINDOW_MS);
#endif
}
static K_WORK_DEFINE(s_open_window_work, open_window_fn);

static void on_button(const struct device *dev, struct gpio_callback *cb, uint32_t pins)
{
	ARG_UNUSED(dev);
	ARG_UNUSED(cb);
	ARG_UNUSED(pins);
	/* Deaf while a factory reset retracts: a bounce or second press opened a
	 * window whose _matterc record the wipe orphaned, and Home dialed it until
	 * its 120 s lease ran out (2026-10-16). */
	if (k_work_delayable_is_pending(&s_reboot_work)) {
		return;
	}
	if (gpio_pin_get_dt(&s_button) == 1) {
		s_pressed_at = k_uptime_get();
		(void)k_work_reschedule(&s_factory_reset_work, K_MSEC(FACTORY_RESET_MS));
		return;
	}
	(void)k_work_cancel_delayable(&s_factory_reset_work);
	if (s_pressed_at >= 0 && k_uptime_get() - s_pressed_at < FACTORY_RESET_MS) {
		k_work_submit(&s_open_window_work);
	}
	s_pressed_at = -1;
}

static int button_init(void)
{
	int rc;

	if (!gpio_is_ready_dt(&s_button)) {
		return -ENODEV;
	}
	rc = gpio_pin_configure_dt(&s_button, GPIO_INPUT);
	if (rc == 0) {
		rc = gpio_pin_interrupt_configure_dt(&s_button, GPIO_INT_EDGE_BOTH);
	}
	if (rc == 0) {
		gpio_init_callback(&s_button_cb, on_button, BIT(s_button.pin));
		rc = gpio_add_callback(s_button.port, &s_button_cb);
	}
	return rc;
}

int main(void)
{
	int rc;

	if (gpio_is_ready_dt(&s_led)) {
		(void)gpio_pin_configure_dt(&s_led, GPIO_OUTPUT_INACTIVE);
	}
	if (button_init() != 0) {
		LOG_WRN("no button: commissioning window and factory reset unavailable");
	}

	if (psa_crypto_init() != PSA_SUCCESS) {
		LOG_ERR("PSA Crypto did not start");
		return 0;
	}
	rc = settings_subsys_init();
	if (rc != 0) {
		LOG_ERR("settings did not start (%d)", rc);
		return 0;
	}
	rc = matter_ble_start();
	if (rc != 0) {
		LOG_ERR("Bluetooth did not start (%d)", rc);
		return 0;
	}
#if defined(CONFIG_TINYCRED)
	cred_configure();
#endif
	rc = matter_commission_init(&s_matter_cfg);
	if (rc != 0) {
		LOG_ERR("Matter node did not start (%d)", rc);
		return 0;
	}

#if defined(CONFIG_TINYFOTA_RECEIVER)
	tinyfota_set_window_cb(on_update_window);
#endif
#if defined(CONFIG_TINYCRED)
	(void)cred_start();
#endif
	LOG_INF("manual pairing code %s, discriminator 0x%03x", TM_SAMPLE_MANUAL_CODE,
		CONFIG_TINYTALK_DISCRIMINATOR);
	matter_commission_readvertise();
	return 0;
}
```

## src/cred.c
```c
/* SPDX-FileCopyrightText: 2026 Aseem Chopra */
/* SPDX-License-Identifier: Apache-2.0 */

/*
 * The credential reader on this lock. tinycred runs the phone's transaction
 * on tinyble's channel and brings ranging up on tinyuwb; this file turns the
 * ranges tinyuwb latches into bolt moves through tinycred's approach
 * controller, and tells the phone and the Matter tile.
 *
 * One thread, woken by every latched range and every TICK_MS: the approach
 * controller is fed trusted ranges, sees untrusted ones for departure only,
 * and ticks in silence. A session ending is a departure too, except for the
 * mid-phase flap that reconnects within seconds, which holds the bolt for a
 * while first.
 */
#include "cred.h"

#include <zephyr/kernel.h>
#include <zephyr/logging/log.h>

#include <tinycred/approach.h>
#include <tinycred/ble_tinyble.h>
#include <tinycred/reader.h>
#include <tinytalk/tm_door_lock.h>
#include <tinyuwb/hw.h>
#include <tinyuwb/range.h>
#include <tinyuwb/uwb.h>

#include <errno.h>
#include <string.h>

LOG_MODULE_REGISTER(cred, LOG_LEVEL_INF);

#define TICK_MS            250
#define FLAP_HOLD_MS       10000
#define FLAP_FEED_FRESH_MS 3000
/* OperationSourceEnum Aliro (door-lock-cluster.xml, OperationSourceEnum). */
#define OP_SOURCE_ALIRO    10u

static K_SEM_DEFINE(s_range_sig, 0, 1);
static struct tc_approach s_approach;
static bool s_granted, s_present;
static bool s_started; /* the reader is up: the phone can be told things */
static bool s_self;    /* bolt() is moving the bolt: not a controller */

static void on_range(void)
{
	k_sem_give(&s_range_sig);
}

/* The phone first (Reader Status Unsecured/Secured, the Wallet animation),
 * whether or not the bolt has to move: its grant is what it is shown. Then
 * the bolt and the tile, only when the bolt does move; the LockOperation
 * event names the Door Lock user the credential is filed under. Once per
 * transition. */
static void bolt(bool unlocked)
{
	uint8_t state = unlocked ? MATTER_DL_LOCK_STATE_UNLOCKED : MATTER_DL_LOCK_STATE_LOCKED;
	uint16_t user = 0u;

	if (s_granted == unlocked) {
		return;
	}
	s_granted = unlocked;
	LOG_INF("approach: %s at %lld ms", unlocked ? "unlock" : "relock",
		(long long)k_uptime_get());
	tc_reader_notify_unlock(unlocked);
	if (tm_door_lock_state() == state) {
		return; /* a controller got there first */
	}
	s_self = true;
	tm_door_lock_actuate(state);
	s_self = false;
	(void)tc_reader_authenticated_user_index(&user);
	tm_door_lock_set_user(state, OP_SOURCE_ALIRO, user);
}

void cred_bolt_moved(uint8_t lock_state)
{
	if (s_started && !s_self) {
		tc_reader_notify_unlock(lock_state == MATTER_DL_LOCK_STATE_UNLOCKED);
	}
}

static void loop(void *a, void *b, void *c)
{
	uint32_t last_gen = tu_rs_generation(), last_obs = last_gen;
	int64_t flap_hold = 0, last_status_ms = 0;
	bool session_was = false;

	ARG_UNUSED(a);
	ARG_UNUSED(b);
	ARG_UNUSED(c);
	for (;;) {
		int64_t now = k_uptime_get();
		uint32_t gen = tu_rs_generation();
		bool session = tc_reader_session_active();
		enum tc_approach_action act;
		int32_t cm = 0;

		tc_reader_status_tick(now);
		if (session && now - last_status_ms >= 2000) {
			struct tu_round_stats rs;
			struct tu_hw_stats hs;
			uint32_t dbg[5];
			int32_t last = -1;
			int64_t age = -1;

			last_status_ms = now;
			tu_round_stats_get(&rs);
			tu_hw_stats_get(&hs);
			tu_hw_debug(dbg);
			(void)tu_rs_last_range(&last, NULL, NULL, NULL, &age);
			LOG_INF("uwb: listen=%d irq=%u tx=%u rx_arm=%u rx_ok=%u rx_to=%u rx_err=%u "
				"[phe %u fce %u fsl %u sto %u pto %u fto %u arfe %u cia %u finfo 0x%08x] | "
				"status=0x%08x state=0x%08x chan=0x%04x pin=%u | "
				"pp=%u arm=%u/%u poll=%u/%u resp=%u final=%u range=%u | gen=%u cm=%d",
				tu_listening(), hs.irq, hs.tx_done, hs.rx_arm, hs.rx_ok, hs.rx_to,
				hs.rx_err, hs.e_phe, hs.e_fce, hs.e_fsl, hs.e_sto, hs.e_pto, hs.e_fto,
				hs.e_arfe, hs.e_cia, hs.last_finfo, dbg[0], dbg[1], dbg[3], dbg[4],
				rs.prepoll_ok, rs.poll_arm, rs.arm_fail, rs.poll_ok, rs.poll_fail,
				rs.resp_tx, rs.final_data, rs.range, gen, last);
			(void)age;
		}
		if (session && !session_was) {
			/* The RSSI gate holds ranging off until the phone is at
			 * the door, so the session coming up is the approach
			 * evidence the controller's trajectory gate wants. */
			tc_approach_session_up(&s_approach);
			s_present = true;
		}
		session_was = session;

		if (gen != last_gen && tu_rs_trusted() &&
		    tu_rs_last_range(&cm, NULL, NULL, NULL, NULL)) {
			last_gen = last_obs = gen;
			act = tc_approach_feed(&s_approach, now, cm);
		} else {
			if (gen != last_obs && tu_rs_last_range(&cm, NULL, NULL, NULL, NULL)) {
				last_obs = gen;
				tc_approach_observe_departure(&s_approach, now, cm);
			}
			act = tc_approach_tick(&s_approach, now);
		}
		switch (act) {
		case TC_APPROACH_UNLOCK_PREDICT:
		case TC_APPROACH_UNLOCK_THRESHOLD:
			bolt(true);
			break;
		case TC_APPROACH_RELOCK_DEPART:
		case TC_APPROACH_RELOCK_ABORT:
			bolt(false);
			break;
		default:
			break;
		}

		if (session) {
			flap_hold = 0;
		} else if (s_present) {
			if (flap_hold == 0 && s_granted && s_approach.last_feed_ms != 0 &&
			    !tc_reader_last_close_established() &&
			    s_approach.last_cm < s_approach.cfg.relock_cm &&
			    now - s_approach.last_feed_ms <= FLAP_FEED_FRESH_MS) {
				flap_hold = now;
				LOG_WRN("session died with the phone at %d cm; holding the bolt",
					s_approach.last_cm);
			}
			if (flap_hold == 0 || now - flap_hold > FLAP_HOLD_MS) {
				flap_hold = 0;
				(void)tc_approach_gone(&s_approach);
				bolt(false);
				s_present = false;
			}
		}
		(void)k_sem_take(&s_range_sig, K_MSEC(TICK_MS));
	}
}

K_THREAD_DEFINE(cred_thread, 2048, loop, NULL, NULL, NULL, K_PRIO_PREEMPT(10), 0,
		K_TICKS_FOREVER);

/* ---- Matter provisioning: the Door Lock cluster's Aliro hooks ---------------
 *
 * The reader identity is group_id || group_sub_id; the issuer keys (type 6)
 * have their own store in tinycred, the endpoint keys (7, 8) are trust
 * anchors. The reader persists each one before returning, which is what the
 * cluster's contract asks.
 */
static int on_reader_config(const uint8_t signing_key[32], const uint8_t verification_key[65],
			    const uint8_t group_id[16], const uint8_t group_sub_id[16],
			    const uint8_t grk[16])
{
	uint8_t reader_id[32];
	int rc;

	ARG_UNUSED(verification_key);
	memcpy(reader_id, group_id, 16u);
	memcpy(reader_id + 16, group_sub_id, 16u);
	rc = tc_reader_provision_identity(reader_id, signing_key, grk);
	memset(reader_id, 0, sizeof(reader_id));
	return rc;
}

static int on_reader_clear(void)
{
	return tc_reader_provision_clear();
}

static int on_credential_set(uint8_t cred_type, const uint8_t key[65], uint16_t cred_index,
			     uint16_t user_index)
{
	int rc = cred_type == MATTER_DL_CRED_ALIRO_ISSUER_KEY
			 ? tc_reader_provision_add_issuer(key, cred_index, user_index)
			 : tc_reader_provision_add_trust(key, cred_type, cred_index, user_index);

	return rc; /* 0 added, 1 already there, < 0 refused */
}

static int on_credential_clear(uint8_t cred_type, uint16_t cred_index)
{
	int rc;

	if (cred_index == MATTER_DL_INDEX_ALL) {
		rc = tc_reader_provision_remove_type(cred_type);
	} else if (cred_type == MATTER_DL_CRED_ALIRO_ISSUER_KEY) {
		rc = tc_reader_provision_remove_issuer(cred_index);
	} else {
		rc = tc_reader_provision_remove_trust(cred_type, cred_index);
	}
	return rc < 0 ? rc : 0;
}

static int on_user_clear(uint16_t user_index)
{
	int rc = tc_reader_provision_remove_user(user_index);

	return rc < 0 ? rc : 0;
}

static const struct tm_door_lock_aliro_hooks k_aliro_hooks = {
	.reader_config = on_reader_config,
	.reader_clear = on_reader_clear,
	.credential_set = on_credential_set,
	.credential_clear = on_credential_clear,
	.credential_lookup = tc_reader_provision_cred_lookup,
	.user_clear = on_user_clear,
};

void cred_configure(void)
{
	tm_door_lock_aliro_configure(&k_aliro_hooks);
}

int cred_start(void)
{
	uint8_t reader_id[32], verif[65], grk[16];
	int rc;

	/* Installs the transaction callbacks on the transport; the attached
	 * start alone does not. */
	(void)tc_reader_ble_prepare();
	rc = tc_reader_start_attached();
	if (rc != 0) {
		LOG_ERR("credential reader did not start (%d)", rc);
		return rc;
	}
	/* What the reader loaded, for the attributes a controller reads back. */
	if (tc_reader_identity_public(reader_id, verif, grk) == 0) {
		tm_door_lock_aliro_set_identity(verif, reader_id, grk);
	}
	tc_approach_init(&s_approach, NULL);
	tu_rs_set_range_listener(on_range);
	k_thread_start(cred_thread);
	s_started = true;
	return 0;
}

void cred_advertise(bool on)
{
	tc_ble_tinyble_advertise(on);
}
```

## src/cred.h
```c
/* SPDX-FileCopyrightText: 2026 Aseem Chopra */
/* SPDX-License-Identifier: Apache-2.0 */

/*
 * The credential reader on this lock (CONFIG_TINYCRED): tinycred on tinyble,
 * ranging on tinyuwb, the approach controller, the bolt. See cred.c.
 */
#pragma once

#include <stdbool.h>
#include <stdint.h>

/* Before the Matter node: the Door Lock cluster's Aliro hooks. */
void cred_configure(void);

/* After the Matter node is up: start the reader and the approach loop. */
int cred_start(void);

/* The bolt moved on a controller's command: a connected phone's Wallet hears
 * it, so it does not keep showing the state its own last grant left. */
void cred_bolt_moved(uint8_t lock_state);

/* The reader's advertisement on tinyble's one advertiser. The commissioning
 * advertisement takes the advertiser while a window is open; the reader has it
 * the rest of the time. */
void cred_advertise(bool on);
```
