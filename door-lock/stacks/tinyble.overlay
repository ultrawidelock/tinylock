/* Zephyr's own controller as the HCI provider, in place of the SoftDevice Controller. */
/ {
	chosen {
		zephyr,bt-hci = &bt_hci_controller;
	};
};

&bt_hci_controller {
	status = "okay";
};

&bt_hci_sdc {
	status = "disabled";
};
